/dts-v1/;
/plugin/;

/ {
    /* Keep kernel stdout on serial0 at 115200 so earlycon and ttyAML0 match. */
    fragment@0 {
        target-path = "/chosen";
        __overlay__ {
            stdout-path = "serial0:115200n8";
        };
    };
};
